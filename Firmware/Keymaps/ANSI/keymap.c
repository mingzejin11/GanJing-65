/* Copyright 2019 mingzejin11
 *
 * This program is free software: you can redistribute it and/or modify
 * it under the terms of the GNU General Public License as published by
 * the Free Software Foundation, either version 2 of the License, or
 * (at your option) any later version.
 *
 * This program is distributed in the hope that it will be useful,
 * but WITHOUT ANY WARRANTY; without even the implied warranty of
 * MERCHANTABILITY or FITNESS FOR A PARTICULAR PURPOSE.  See the
 * GNU General Public License for more details.
 *
 * You should have received a copy of the GNU General Public License
 * along with this program.  If not, see <http://www.gnu.org/licenses/>.
 */

#include "GanJing-keyboard.h"
#include "analog.h"
#include <stdio.h>

// Each layer gets a name for readability, which is then used in the keymap matrix below.
// The underscores don't mean anything - you can have a layer called STUFF or any other name.
#define MN 0
#define FN 1

char wpm_str[10];

void encoder_update_user(uint16_t index, bool clockwise) {
	if (clockwise) {
		tap_code(KC_VOLU);
	} else {
		tap_code(KC_VOLD);
	}
}

const uint16_t PROGMEM keymaps[][MATRIX_ROWS][MATRIX_COLS] = {
	// Keymap MN: Main Layer (Default Layer)
	[MN] = LAYOUT_65_ansi(
		KC_GESC, KC_1,    KC_2,    KC_3,    KC_4,    KC_5,    KC_6,    KC_7,    KC_8,    KC_9,    KC_0,    KC_MINS, KC_EQL,  KC_BSPC, KC_MUTE,
		KC_TAB,  KC_Q,    KC_W,    KC_E,    KC_R,    KC_T,    KC_Y,    KC_U,    KC_I,    KC_O,    KC_P,    KC_LBRC, KC_RBRC, KC_BSLS, KC_DEL,
		KC_CAPS, KC_A,    KC_S,    KC_D,    KC_F,    KC_G,    KC_H,    KC_J,    KC_K,    KC_L,    KC_SCLN, KC_QUOT,          KC_ENT,  KC_PGUP,
		KC_LSFT,          KC_Z,    KC_X,    KC_C,    KC_V,    KC_B,    KC_N,    KC_M,    KC_COMM, KC_DOT,  KC_SLSH, KC_RSFT, KC_UP,   KC_PGDN,
		KC_LCTL, KC_LGUI, KC_LALT,                            KC_SPC,                                      MO(FN),  KC_LEFT, KC_DOWN, KC_RGHT),

	// Keymap FN: Function Layer
	[FN] = LAYOUT_65_ansi(
		/* esc     1        2        3        4        5        6        7        8        9        0        -        =      bkspc     mute  */
		KC_GRV,  KC_F1,   KC_F2,   KC_F3,   KC_F4,   KC_F5,   KC_F6,   KC_F7,   KC_F8,   KC_F9,   KC_F10,  KC_F11,  KC_F12,  KC_TRNS, KC_TRNS,
		/* tab     Q        W        E        R        T        Y        U        I        O        P        [        ]        \      delete */ 
		KC_TRNS, KC_TRNS, KC_TRNS, KC_TRNS, KC_TRNS, KC_TRNS, KC_TRNS, KC_TRNS, KC_TRNS, KC_TRNS, KC_TRNS, KC_TRNS, KC_TRNS, KC_TRNS, KC_INS,
		/* caps    A        S        D        F        G        H        J        K        L        ;        '               enter    pg up  */
		KC_TRNS, KC_TRNS, KC_TRNS, KC_TRNS, KC_TRNS, KC_TRNS, KC_TRNS, KC_TRNS, KC_TRNS, KC_TRNS, KC_TRNS, KC_TRNS,          KC_TRNS, KC_HOME,
		/* shift            Z        X        C        V        B        N        M        ,        .        /      shift      up     pg dn  */
		KC_TRNS,          KC_TRNS, KC_TRNS, KC_TRNS, KC_TRNS, KC_TRNS, KC_TRNS, KC_TRNS, KC_TRNS, KC_BRIU, KC_BRID, KC_TRNS, KC_TRNS, KC_END,
		/* ctrl   win      alt                                space                                          Fn      left      down   right  */
		KC_TRNS, KC_TRNS, KC_TRNS,                            KC_TRNS,                                     MO(MN),  KC_MPRV, KC_MPLY, KC_MNXT),
};

#ifdef OLED_DRIVER_ENABLE

// oled_rotation_t oled_init_user(oled_rotation_t rotation) {
//     return OLED_ROTATION_180;
// }

// WPM-responsive animation stuff here
// Idle parameters
#define IDLE_FRAMES 5
#define IDLE_SPEED 10 // below this wpm value your animation will idle

// Start parameters
#define START_FRAMES 1 // uncomment if >1
#define START_SPEED 20

// Tap parameters
#define TAP_FRAMES 2
#define TAP_SPEED 60 // above this WPM value the tapping gets hard

// Surrender parameters
#define SURRENDER_FRAMES 5
#define SURRENDER_SPEED 100

#define ANIM_FRAME_DURATION 200 // how long each frame lasts in ms
// #define SLEEP_TIMER 60000 // should sleep after this period of 0 wpm, needs fixing
#define ANIM_SIZE 636 // number of bytes in array, minimize for adequate firmware size, max is 1024

uint32_t anim_timer = 0;
uint32_t anim_sleep = 0;
uint8_t current_idle_frame = 0;
// uint8_t current_prep_frame = 0; // uncomment if PREP_FRAMES > 1
uint8_t current_tap_frame = 0;
uint8_t current_surrender_frame = 0;

// Images credit to Pixelbenny
static void render_anim(void) {
	static const char PROGMEM idle[IDLE_FRAMES][ANIM_SIZE] = {
		{ // Idle 1
			0xff,0xff,0xff,0xff,0xff,0xff,0xff,0xff,0xff,0xff,0xff,0xff,0xff,0xff,0xff,
			0xff,0xff,0xff,0xff,0xff,0x9f,0xff,0xff,0xff,0xff,0xff,0xff,0xff,0xff,0xff,
			0xff,0xff,0xff,0xff,0xff,0xff,0x6f,0xff,0xff,0xff,0xff,0xff,0xff,0xff,0xff,
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			0xff,0xff
		},
		{ // Idle 2
			0xff,0xff,0xff,0xff,0xff,0xff,0xff,0xff,0xff,0xff,0xff,0xff,0xff,0xff,0xff,
			0xff,0xff,0xff,0xff,0xff,0xff,0xff,0xff,0xff,0xff,0xff,0xff,0xff,0xff,0xff,
			0xff,0xff,0xff,0xff,0xff,0xff,0x9f,0xff,0xff,0xff,0xff,0xff,0xff,0xff,0xff,
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			0xff,0xff
		},
		{ // Idle 3
			0xff,0xff,0xff,0xff,0xff,0xff,0xff,0xff,0xff,0xff,0xff,0xff,0xff,0xff,0xff,
			0xff,0xff,0xff,0xff,0xff,0xff,0xff,0xff,0xff,0xff,0xff,0xff,0xff,0xff,0xff,
			0xff,0xff,0xff,0xff,0xff,0xff,0xff,0xff,0xff,0xff,0xff,0xff,0xff,0xff,0xff,
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			0xff,0xff
		},
		{ // Idle 4
			0xff,0xff,0xff,0xff,0xff,0xff,0xff,0xff,0xff,0xff,0xff,0xff,0xff,0xff,0xff,
			0xff,0xff,0xff,0xff,0xff,0xff,0xff,0xff,0xff,0xff,0xff,0xff,0xff,0xff,0xff,
			0xff,0xff,0xff,0xff,0xff,0xff,0xff,0xff,0xff,0xff,0xff,0xff,0xff,0xff,0xff,
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			0xff,0xff
		},
		{ // Idle 5
			0xff,0xff,0xff,0xff,0xff,0xff,0xff,0xff,0xff,0xff,0xff,0xff,0xff,0xff,0xff,
			0xff,0xff,0xff,0xff,0xff,0xff,0xff,0xff,0xff,0xff,0xff,0xff,0xff,0xff,0xff,
			0xff,0xff,0xff,0xff,0xff,0xff,0x8f,0xff,0xff,0xff,0xff,0xff,0xff,0xff,0xff,
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			0xff,0xff
		}
	};

	static const char PROGMEM start[][ANIM_SIZE] = {
		{ // start
			0xff,0xff,0xff,0xff,0xff,0xff,0xff,0xff,0xff,0xff,0xff,0xff,0xff,0xff,0xff,
			0xff,0xff,0xff,0xff,0xff,0x9f,0xff,0xff,0xff,0xff,0xff,0xff,0xff,0xff,0xff,
			0xff,0xff,0xff,0xff,0xff,0xff,0x6f,0xff,0xff,0xff,0xff,0xff,0xff,0xff,0xff,
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			0xff,0xff
		}
	};

	static const char PROGMEM soft[TAP_FRAMES][ANIM_SIZE] = {
		{ // Left up soft
			0xff,0xff,0xff,0xff,0xff,0xff,0xff,0xff,0xff,0xff,0xff,0xff,0xff,0xff,0xff,
			0xff,0xff,0xff,0xff,0xff,0x9f,0xff,0xff,0xff,0xff,0xff,0xff,0xff,0xff,0xff,
			0xff,0xff,0xff,0xff,0xff,0xff,0x6f,0xff,0xff,0xff,0xff,0xff,0xff,0xff,0xff,
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			0xff,0xff
		},
		{ // Right up soft
			0xff,0xff,0xff,0xff,0xff,0xff,0xff,0xff,0xff,0xff,0xff,0xff,0xff,0xff,0xff,
			0xff,0xff,0xff,0xff,0xff,0x9f,0xff,0xff,0xff,0xff,0xff,0xff,0xff,0xff,0xff,
			0xff,0xff,0xff,0xff,0xff,0xff,0x6f,0xff,0xff,0xff,0xff,0xff,0xff,0xff,0xff,
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			0xff,0xff
		}
	};

	static const char PROGMEM hard[TAP_FRAMES][ANIM_SIZE] = {
		{ // Left up hard
			0xff,0xff,0xff,0xff,0xff,0xff,0xff,0xff,0xff,0xff,0xff,0xff,0xff,0xff,0xff,
			0xff,0xff,0xff,0xff,0xff,0x9f,0xff,0xff,0xff,0xff,0xff,0xff,0xff,0xff,0xff,
			0xff,0xff,0xff,0xff,0xff,0xff,0x6f,0xff,0xff,0xff,0xfc,0xff,0xff,0xff,0xff,
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			0xff,0xff
		},
		{ // Right up hard
			0xff,0xff,0xff,0xff,0xff,0xff,0xff,0xff,0xff,0xff,0xff,0xff,0xff,0xff,0xff,
			0xff,0xff,0xff,0xff,0xff,0x9f,0xff,0xff,0xff,0xff,0xff,0xff,0xff,0xff,0xff,
			0xff,0xff,0xff,0xff,0xff,0xff,0x6f,0xff,0xff,0xff,0xff,0xff,0xff,0xff,0xff,
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			0xff,0xff
		}
	};

	static const char PROGMEM surrender[SURRENDER_FRAMES][ANIM_SIZE] = {
		{ // Surrender 1
			0xff,0xff,0xff,0xff,0xff,0xff,0xff,0xff,0xff,0xff,0xff,0xff,0xff,0xff,0xff,
			0xff,0xff,0xff,0xff,0xff,0xff,0xff,0xff,0xff,0xff,0xff,0xff,0xff,0xff,0xff,
			0xff,0xff,0xff,0xff,0xff,0xff,0xff,0x39,0xfc,0xf0,0xff,0xff,0xff,0xff,0xff,
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			0xff,0xff
		},
		{ // Surrender 2
			0xff,0xff,0xff,0xff,0xff,0xff,0xff,0xff,0xff,0xff,0xff,0xff,0xff,0xff,0xff,
			0xff,0xff,0xff,0xff,0xff,0xff,0xff,0xff,0xff,0xff,0xff,0xff,0xff,0xff,0xff,
			0xff,0xff,0xff,0xff,0xff,0xff,0xff,0xf9,0xf0,0xc3,0xff,0xff,0xff,0xff,0xff,
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			0xff,0xff
		},
		{ // Surrender 3
			0xff,0xff,0xff,0xff,0xff,0xff,0xff,0xff,0xff,0xff,0xff,0xff,0xff,0xff,0xff,
			0xff,0xff,0xff,0xff,0xff,0xff,0xff,0xff,0xff,0xff,0xff,0xff,0xff,0xff,0xff,
			0xff,0xff,0xff,0xff,0xff,0xff,0xff,0xf9,0xc3,0xcf,0xff,0xff,0xff,0xff,0xff,
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			0xff,0xff
		},
		{ // Surrender 4
			0xff,0xff,0xff,0xff,0xff,0xff,0xff,0xff,0xff,0xff,0xff,0xff,0xff,0xff,0xff,
			0xff,0xff,0xff,0xff,0xff,0xff,0xff,0xff,0xff,0xff,0xff,0xff,0xff,0xff,0xff,
			0xff,0xff,0xff,0xff,0xff,0xff,0xff,0xc9,0x0f,0xff,0xff,0xff,0xff,0xff,0xff,
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			0xff,0xff
		},
		{ // Surrender 5
			0xff,0xff,0xff,0xff,0xff,0xff,0xff,0xff,0xff,0xff,0xff,0xff,0xff,0xff,0xff,
			0xff,0xff,0xff,0xff,0xff,0xff,0xff,0xff,0xff,0xff,0xff,0xff,0xff,0xff,0xff,
			0xff,0xff,0xff,0xff,0xff,0xff,0xff,0x09,0x3f,0xfc,0xff,0xff,0xff,0xff,0xff,
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			0xff,0xff
		}
	};

	// Assumes 1 frame prep stage
	void animation_phase(void) {
		// Idle
		if (get_current_wpm() < IDLE_SPEED) {
			current_idle_frame = (current_idle_frame + 1) % IDLE_FRAMES;
			oled_write_raw_P(idle[abs((IDLE_FRAMES - 1) - current_idle_frame)], ANIM_SIZE);
		}

		// Start
		if (get_current_wpm() >= IDLE_SPEED && get_current_wpm() < START_SPEED) {
			oled_write_raw_P(start[0], ANIM_SIZE);
		}

		// Soft tap
		if (get_current_wpm() >= START_SPEED && get_current_wpm() < TAP_SPEED) {
			current_tap_frame = (current_tap_frame + 1) % TAP_FRAMES;
			oled_write_raw_P(soft[abs((TAP_FRAMES - 1) - current_tap_frame)], ANIM_SIZE);
		}

		// Hard tap
		if (get_current_wpm() >= TAP_SPEED && get_current_wpm() < SURRENDER_SPEED) {
			current_tap_frame = (current_tap_frame + 1) % TAP_FRAMES;
			oled_write_raw_P(hard[abs((TAP_FRAMES - 1) - current_tap_frame)], ANIM_SIZE);
		}

		// Surrender
		if (get_current_wpm() >= SURRENDER_SPEED) {
			current_surrender_frame = (current_surrender_frame + 1) % SURRENDER_FRAMES;
			oled_write_raw_P(surrender[abs((SURRENDER_FRAMES - 1) - current_surrender_frame)], ANIM_SIZE);
		}
	}

	if (get_current_wpm() != 000) {
		oled_on(); // not essential but turns on animation OLED with any alpha keypress
		if (timer_elapsed32(anim_timer) > ANIM_FRAME_DURATION) {
			anim_timer = timer_read32();
			animation_phase();
		}

		anim_sleep = timer_read32();
	} else {
		if (timer_elapsed32(anim_sleep) > OLED_TIMEOUT) {
			oled_off();
		} else {
			if (timer_elapsed32(anim_timer) > ANIM_FRAME_DURATION) {
				anim_timer = timer_read32();
				animation_phase();
			}
		}
	}
}

void oled_task_user(void) {
	render_anim();
	oled_set_cursor(0, 6);
	sprintf(wpm_str, " WPM: %03d", get_current_wpm());
	oled_write(wpm_str, false);
}

#endif
